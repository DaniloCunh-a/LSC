## stm32mp-yocto/meta-diebold/conf/layer.conf
```bitbake
# We have a conf and classes directory, add to BBPATH
BBPATH .= ":${LAYERDIR}"

# We have recipes-* directories, add to BBFILES
BBFILES += "${LAYERDIR}/recipes-*/*/*.bb \
            ${LAYERDIR}/recipes-*/*/*.bbappend"

BBFILE_COLLECTIONS += "meta-diebold"
BBFILE_PATTERN_meta-diebold = "^${LAYERDIR}/"
BBFILE_PRIORITY_meta-diebold = "6"

LAYERDEPENDS_meta-diebold = "core swupdate"
LAYERSERIES_COMPAT_meta-diebold = "kirkstone"
```
